## bench/main/Kconfig.projbuild
```kconfig
menu "Bench harness options"
    config BENCH_AES_SWEEP_ONLY
        bool "Run only the AES-GCM sweep (skip Ascon + ML-KEM)"
        default n
        help
            Set to y by the aes-sw build presets so the sw-only run doesn't
            waste time re-measuring Ascon/ML-KEM, which the primary preset
            already covers.
    
    config BENCH_GATE64_ONLY
        bool "Bachmann opt64 calibration gate only (Phase 4)"
        default n
        help
            Set to y by the gate64 build presets. Runs only the Phase 4
            Bachmann opt64 gate (Ascon-128a and Ascon-128 at 32 KB) and
            skips the Phase 3 Ascon opt32 sweep, ML-KEM, and AES-GCM.
endmenu
```

## bench/sdkconfig.defaults
```kconfig
CONFIG_COMPILER_OPTIMIZATION_PERF=y
CONFIG_PM_ENABLE=n
CONFIG_FREERTOS_USE_TICKLESS_IDLE=n
CONFIG_ESP_TASK_WDT_INIT=n
CONFIG_ESP_MAIN_TASK_STACK_SIZE=65536
```
